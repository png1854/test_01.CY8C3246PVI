#ifndef INCLUDED_CYFITTERKEIL_INC
#define INCLUDED_CYFITTERKEIL_INC
$INCLUDE (cydevicekeil.inc)
$INCLUDE (cydevicekeil_trm.inc)

; SI
SI__0__MASK EQU 0x01
SI__0__PC EQU CYREG_PRT0_PC0
SI__0__PORT EQU 0
SI__0__SHIFT EQU 0
SI__AG EQU CYREG_PRT0_AG
SI__AMUX EQU CYREG_PRT0_AMUX
SI__BIE EQU CYREG_PRT0_BIE
SI__BIT_MASK EQU CYREG_PRT0_BIT_MASK
SI__BYP EQU CYREG_PRT0_BYP
SI__CTL EQU CYREG_PRT0_CTL
SI__DM0 EQU CYREG_PRT0_DM0
SI__DM1 EQU CYREG_PRT0_DM1
SI__DM2 EQU CYREG_PRT0_DM2
SI__DR EQU CYREG_PRT0_DR
SI__INP_DIS EQU CYREG_PRT0_INP_DIS
SI__LCD_COM_SEG EQU CYREG_PRT0_LCD_COM_SEG
SI__LCD_EN EQU CYREG_PRT0_LCD_EN
SI__MASK EQU 0x01
SI__PORT EQU 0
SI__PRT EQU CYREG_PRT0_PRT
SI__PRTDSI__CAPS_SEL EQU CYREG_PRT0_CAPS_SEL
SI__PRTDSI__DBL_SYNC_IN EQU CYREG_PRT0_DBL_SYNC_IN
SI__PRTDSI__OE_SEL0 EQU CYREG_PRT0_OE_SEL0
SI__PRTDSI__OE_SEL1 EQU CYREG_PRT0_OE_SEL1
SI__PRTDSI__OUT_SEL0 EQU CYREG_PRT0_OUT_SEL0
SI__PRTDSI__OUT_SEL1 EQU CYREG_PRT0_OUT_SEL1
SI__PRTDSI__SYNC_OUT EQU CYREG_PRT0_SYNC_OUT
SI__PS EQU CYREG_PRT0_PS
SI__SHIFT EQU 0
SI__SLW EQU CYREG_PRT0_SLW

; RCK
RCK__0__MASK EQU 0x04
RCK__0__PC EQU CYREG_PRT0_PC2
RCK__0__PORT EQU 0
RCK__0__SHIFT EQU 2
RCK__AG EQU CYREG_PRT0_AG
RCK__AMUX EQU CYREG_PRT0_AMUX
RCK__BIE EQU CYREG_PRT0_BIE
RCK__BIT_MASK EQU CYREG_PRT0_BIT_MASK
RCK__BYP EQU CYREG_PRT0_BYP
RCK__CTL EQU CYREG_PRT0_CTL
RCK__DM0 EQU CYREG_PRT0_DM0
RCK__DM1 EQU CYREG_PRT0_DM1
RCK__DM2 EQU CYREG_PRT0_DM2
RCK__DR EQU CYREG_PRT0_DR
RCK__INP_DIS EQU CYREG_PRT0_INP_DIS
RCK__LCD_COM_SEG EQU CYREG_PRT0_LCD_COM_SEG
RCK__LCD_EN EQU CYREG_PRT0_LCD_EN
RCK__MASK EQU 0x04
RCK__PORT EQU 0
RCK__PRT EQU CYREG_PRT0_PRT
RCK__PRTDSI__CAPS_SEL EQU CYREG_PRT0_CAPS_SEL
RCK__PRTDSI__DBL_SYNC_IN EQU CYREG_PRT0_DBL_SYNC_IN
RCK__PRTDSI__OE_SEL0 EQU CYREG_PRT0_OE_SEL0
RCK__PRTDSI__OE_SEL1 EQU CYREG_PRT0_OE_SEL1
RCK__PRTDSI__OUT_SEL0 EQU CYREG_PRT0_OUT_SEL0
RCK__PRTDSI__OUT_SEL1 EQU CYREG_PRT0_OUT_SEL1
RCK__PRTDSI__SYNC_OUT EQU CYREG_PRT0_SYNC_OUT
RCK__PS EQU CYREG_PRT0_PS
RCK__SHIFT EQU 2
RCK__SLW EQU CYREG_PRT0_SLW

; SCK
SCK__0__MASK EQU 0x02
SCK__0__PC EQU CYREG_PRT0_PC1
SCK__0__PORT EQU 0
SCK__0__SHIFT EQU 1
SCK__AG EQU CYREG_PRT0_AG
SCK__AMUX EQU CYREG_PRT0_AMUX
SCK__BIE EQU CYREG_PRT0_BIE
SCK__BIT_MASK EQU CYREG_PRT0_BIT_MASK
SCK__BYP EQU CYREG_PRT0_BYP
SCK__CTL EQU CYREG_PRT0_CTL
SCK__DM0 EQU CYREG_PRT0_DM0
SCK__DM1 EQU CYREG_PRT0_DM1
SCK__DM2 EQU CYREG_PRT0_DM2
SCK__DR EQU CYREG_PRT0_DR
SCK__INP_DIS EQU CYREG_PRT0_INP_DIS
SCK__LCD_COM_SEG EQU CYREG_PRT0_LCD_COM_SEG
SCK__LCD_EN EQU CYREG_PRT0_LCD_EN
SCK__MASK EQU 0x02
SCK__PORT EQU 0
SCK__PRT EQU CYREG_PRT0_PRT
SCK__PRTDSI__CAPS_SEL EQU CYREG_PRT0_CAPS_SEL
SCK__PRTDSI__DBL_SYNC_IN EQU CYREG_PRT0_DBL_SYNC_IN
SCK__PRTDSI__OE_SEL0 EQU CYREG_PRT0_OE_SEL0
SCK__PRTDSI__OE_SEL1 EQU CYREG_PRT0_OE_SEL1
SCK__PRTDSI__OUT_SEL0 EQU CYREG_PRT0_OUT_SEL0
SCK__PRTDSI__OUT_SEL1 EQU CYREG_PRT0_OUT_SEL1
SCK__PRTDSI__SYNC_OUT EQU CYREG_PRT0_SYNC_OUT
SCK__PS EQU CYREG_PRT0_PS
SCK__SHIFT EQU 1
SCK__SLW EQU CYREG_PRT0_SLW

; Miscellaneous
BCLK__BUS_CLK__HZ EQU 50000000
BCLK__BUS_CLK__KHZ EQU 50000
BCLK__BUS_CLK__MHZ EQU 50
CYDEV_CHIP_DIE_LEOPARD EQU 1
CYDEV_CHIP_DIE_PANTHER EQU 4
CYDEV_CHIP_DIE_PSOC4A EQU 2
CYDEV_CHIP_DIE_PSOC5LP EQU 5
CYDEV_CHIP_DIE_UNKNOWN EQU 0
CYDEV_CHIP_FAMILY_PSOC3 EQU 1
CYDEV_CHIP_FAMILY_PSOC4 EQU 2
CYDEV_CHIP_FAMILY_PSOC5 EQU 3
CYDEV_CHIP_FAMILY_UNKNOWN EQU 0
CYDEV_CHIP_FAMILY_USED EQU CYDEV_CHIP_FAMILY_PSOC3
CYDEV_CHIP_JTAG_ID EQU 0x1E093069
CYDEV_CHIP_MEMBER_3A EQU 1
CYDEV_CHIP_MEMBER_4A EQU 2
CYDEV_CHIP_MEMBER_4D EQU 3
CYDEV_CHIP_MEMBER_5A EQU 4
CYDEV_CHIP_MEMBER_5B EQU 5
CYDEV_CHIP_MEMBER_UNKNOWN EQU 0
CYDEV_CHIP_MEMBER_USED EQU CYDEV_CHIP_MEMBER_3A
CYDEV_CHIP_DIE_EXPECT EQU CYDEV_CHIP_MEMBER_USED
CYDEV_CHIP_DIE_ACTUAL EQU CYDEV_CHIP_DIE_EXPECT
CYDEV_CHIP_REV_LEOPARD_ES1 EQU 0
CYDEV_CHIP_REV_LEOPARD_ES2 EQU 1
CYDEV_CHIP_REV_LEOPARD_ES3 EQU 3
CYDEV_CHIP_REV_LEOPARD_PRODUCTION EQU 3
CYDEV_CHIP_REV_PANTHER_ES0 EQU 0
CYDEV_CHIP_REV_PANTHER_ES1 EQU 1
CYDEV_CHIP_REV_PANTHER_PRODUCTION EQU 1
CYDEV_CHIP_REV_PSOC4A_ES0 EQU 17
CYDEV_CHIP_REV_PSOC4A_PRODUCTION EQU 17
CYDEV_CHIP_REV_PSOC5LP_ES0 EQU 0
CYDEV_CHIP_REV_PSOC5LP_PRODUCTION EQU 0
CYDEV_CHIP_REVISION_3A_ES1 EQU 0
CYDEV_CHIP_REVISION_3A_ES2 EQU 1
CYDEV_CHIP_REVISION_3A_ES3 EQU 3
CYDEV_CHIP_REVISION_3A_PRODUCTION EQU 3
CYDEV_CHIP_REVISION_4A_ES0 EQU 17
CYDEV_CHIP_REVISION_4A_PRODUCTION EQU 17
CYDEV_CHIP_REVISION_4D_ES0 EQU 0
CYDEV_CHIP_REVISION_4D_PRODUCTION EQU 0
CYDEV_CHIP_REVISION_5A_ES0 EQU 0
CYDEV_CHIP_REVISION_5A_ES1 EQU 1
CYDEV_CHIP_REVISION_5A_PRODUCTION EQU 1
CYDEV_CHIP_REVISION_5B_ES0 EQU 0
CYDEV_CHIP_REVISION_5B_PRODUCTION EQU 0
CYDEV_CHIP_REVISION_USED EQU CYDEV_CHIP_REVISION_3A_PRODUCTION
CYDEV_CHIP_REV_EXPECT EQU CYDEV_CHIP_REVISION_USED
CYDEV_CONFIG_FASTBOOT_ENABLED EQU 1
CYDEV_CONFIG_UNUSED_IO_AllowButWarn EQU 0
CYDEV_CONFIG_UNUSED_IO EQU CYDEV_CONFIG_UNUSED_IO_AllowButWarn
CYDEV_CONFIG_UNUSED_IO_AllowWithInfo EQU 1
CYDEV_CONFIG_UNUSED_IO_Disallowed EQU 2
CYDEV_CONFIGURATION_CLEAR_SRAM EQU 1
CYDEV_CONFIGURATION_COMPRESSED EQU 1
CYDEV_CONFIGURATION_DMA EQU 0
CYDEV_CONFIGURATION_ECC EQU 1
CYDEV_CONFIGURATION_IMOENABLED EQU CYDEV_CONFIG_FASTBOOT_ENABLED
CYDEV_CONFIGURATION_MODE_COMPRESSED EQU 0
CYDEV_CONFIGURATION_MODE EQU CYDEV_CONFIGURATION_MODE_COMPRESSED
CYDEV_CONFIGURATION_MODE_DMA EQU 2
CYDEV_CONFIGURATION_MODE_UNCOMPRESSED EQU 1
CYDEV_DEBUG_ENABLE_MASK EQU 0x01
CYDEV_DEBUG_ENABLE_REGISTER EQU CYREG_MLOGIC_DEBUG
CYDEV_DEBUGGING_DPS_Disable EQU 3
CYDEV_DEBUGGING_DPS_JTAG_4 EQU 1
CYDEV_DEBUGGING_DPS_JTAG_5 EQU 0
CYDEV_DEBUGGING_DPS_SWD EQU 2
CYDEV_DEBUGGING_DPS_SWD_SWV EQU 6
CYDEV_DEBUGGING_DPS EQU CYDEV_DEBUGGING_DPS_SWD_SWV
CYDEV_DEBUGGING_ENABLE EQU 1
CYDEV_DEBUGGING_XRES EQU 1
CYDEV_DMA_CHANNELS_AVAILABLE EQU 24
CYDEV_ECC_ENABLE EQU 0
CYDEV_INSTRUCT_CACHE_ENABLED EQU 1
CYDEV_INTR_RISING EQU 0x00000000
CYDEV_PROJ_TYPE EQU 0
CYDEV_PROJ_TYPE_BOOTLOADER EQU 1
CYDEV_PROJ_TYPE_LOADABLE EQU 2
CYDEV_PROJ_TYPE_MULTIAPPBOOTLOADER EQU 3
CYDEV_PROJ_TYPE_STANDARD EQU 0
CYDEV_PROTECTION_ENABLE EQU 0
CYDEV_VARIABLE_VDDA EQU 0
CYDEV_VDDA LIT '5.0'
CYDEV_VDDA_MV EQU 5000
CYDEV_VDDD LIT '5.0'
CYDEV_VDDD_MV EQU 5000
CYDEV_VDDIO0 LIT '5.0'
CYDEV_VDDIO0_MV EQU 5000
CYDEV_VDDIO1 LIT '5.0'
CYDEV_VDDIO1_MV EQU 5000
CYDEV_VDDIO2 LIT '5.0'
CYDEV_VDDIO2_MV EQU 5000
CYDEV_VDDIO3 LIT '5.0'
CYDEV_VDDIO3_MV EQU 5000
CYDEV_VIO0 EQU 5
CYDEV_VIO0_MV EQU 5000
CYDEV_VIO1 EQU 5
CYDEV_VIO1_MV EQU 5000
CYDEV_VIO2 EQU 5
CYDEV_VIO2_MV EQU 5000
CYDEV_VIO3 EQU 5
CYDEV_VIO3_MV EQU 5000
CYIPBLOCK_DP8051_VERSION EQU 0
CYIPBLOCK_P3_ANAIF_VERSION EQU 0
CYIPBLOCK_P3_CAPSENSE_VERSION EQU 0
CYIPBLOCK_P3_COMP_VERSION EQU 0
CYIPBLOCK_P3_DECIMATOR_VERSION EQU 0
CYIPBLOCK_P3_DMA_VERSION EQU 0
CYIPBLOCK_P3_DRQ_VERSION EQU 0
CYIPBLOCK_P3_DSM_VERSION EQU 0
CYIPBLOCK_P3_EMIF_VERSION EQU 0
CYIPBLOCK_P3_I2C_VERSION EQU 0
CYIPBLOCK_P3_LCD_VERSION EQU 0
CYIPBLOCK_P3_LPF_VERSION EQU 0
CYIPBLOCK_P3_PM_VERSION EQU 0
CYIPBLOCK_P3_TIMER_VERSION EQU 0
CYIPBLOCK_P3_USB_VERSION EQU 0
CYIPBLOCK_P3_VIDAC_VERSION EQU 0
CYIPBLOCK_P3_VREF_VERSION EQU 0
CYIPBLOCK_S8_GPIO_VERSION EQU 0
CYIPBLOCK_S8_IRQ_VERSION EQU 0
CYIPBLOCK_S8_SIO_VERSION EQU 0
CYIPBLOCK_S8_UDB_VERSION EQU 0
DMA_CHANNELS_USED__MASK0 EQU 0x00000000
CYDEV_BOOTLOADER_ENABLE EQU 0

#endif /* INCLUDED_CYFITTERKEIL_INC */
